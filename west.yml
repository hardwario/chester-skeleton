## west.yml
```yaml
manifest:
  version: "0.12"
  remotes:
    - name: hardwario
      url-base: https://github.com/hardwario
  projects:
    - name: chester-sdk.git
      remote: hardwario
      revision: v4.0.0
      path: chester
      import: true
  self:
    path: vendor
```
